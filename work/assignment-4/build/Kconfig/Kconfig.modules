## work/assignment-4/build/Kconfig/Kconfig.modules
```kconfig
menu "cmsis (/home/aki/zephyrproject/modules/hal/cmsis)"
osource "$(ZEPHYR_CMSIS_KCONFIG)"
config ZEPHYR_CMSIS_MODULE
	bool
	default y
endmenu
config ZEPHYR_TI_MODULE
	bool
	default y
config ZEPHYR_LIBMETAL_MODULE
	bool
	default y
config ZEPHYR_OPEN_AMP_MODULE
	bool
	default y
```

## work/assignment-4/build/Kconfig/Kconfig.sysbuild.modules
```kconfig
config ZEPHYR_CMSIS_MODULE
   bool
   default y
config ZEPHYR_TI_MODULE
   bool
   default y
config ZEPHYR_LIBMETAL_MODULE
   bool
   default y
config ZEPHYR_OPEN_AMP_MODULE
   bool
   default y
```

## work/assignment-4/build/Kconfig/boards/Kconfig.defconfig
```kconfig
# Load Zephyr board defconfig descriptions.
osource "/home/aki/zephyrproject/zephyr/boards/beagle/beagley_ai/Kconfig.defconfig"
```

## work/blinky/build/Kconfig/boards/Kconfig
```kconfig
# Load Zephyr board Kconfig descriptions.
osource "/home/aki/zephyrproject/zephyr/boards/beagle/beagley_ai/Kconfig"
```

## work/neopixel/build/Kconfig/arch/Kconfig
```kconfig
# Load Zephyr Arch Kconfig descriptions.
osource "/home/aki/zephyrproject/zephyr/arch/x86/Kconfig"
osource "/home/aki/zephyrproject/zephyr/arch/xtensa/Kconfig"
osource "/home/aki/zephyrproject/zephyr/arch/sparc/Kconfig"
osource "/home/aki/zephyrproject/zephyr/arch/riscv/Kconfig"
osource "/home/aki/zephyrproject/zephyr/arch/posix/Kconfig"
osource "/home/aki/zephyrproject/zephyr/arch/nios2/Kconfig"
osource "/home/aki/zephyrproject/zephyr/arch/mips/Kconfig"
osource "/home/aki/zephyrproject/zephyr/arch/arm64/Kconfig"
osource "/home/aki/zephyrproject/zephyr/arch/arm/Kconfig"
osource "/home/aki/zephyrproject/zephyr/arch/arc/Kconfig"
```

## work/neopixel/build/Kconfig/boards/Kconfig.beagley_ai
```kconfig
# Load board Kconfig descriptions.
osource "/home/aki/zephyrproject/zephyr/boards/beagle/beagley_ai/Kconfig.beagley_ai"
```
